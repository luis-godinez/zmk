## app/boards/arm/gmmk_pro_bt/Kconfig.board
```kconfig
# Copyright (c) 2022 UNGODLY DESIGN
# SPDX-License-Identifier: MIT

config BOARD_GMMK_PRO_BT
	bool "GMMK PRO BT"
	depends on SOC_NRF52840_QIAA
```

## app/boards/arm/gmmk_pro_bt/Kconfig.defconfig
```kconfig
# Copyright (c) 2022 UNGODLY DESIGN
# SPDX-License-Identifier: MIT

if BOARD_GMMK_PRO_BT

config ZMK_KEYBOARD_NAME
	default "GMMK PRO BT"

if USB_DEVICE_STACK

config USB_NRFX
	default y

endif # USB_DEVICE_STACK

config BT_CTLR
	default BT

config ZMK_BLE
	default y

config ZMK_USB
	default y

endif # BOARD_GMMK_PRO_BT
```

## app/boards/shields/taw60/Kconfig
```kconfig
# Copyright (c) 2022 Luis Godinez
# SPDX-License-Identifier: MIT

config BOARD_ENABLE_DCDC
	bool "Enable DCDC mode"
	select SOC_DCDC_NRF52X
	default y
	depends on BOARD_TAW60
```

## app/boards/shields/taw60/Kconfig.board
```kconfig
# Copyright (c) 2022 Luis Godinez
# SPDX-License-Identifier: MIT

config BOARD_TAW60
	bool "taw60"
	depends on SOC_NRF52840_QIAA
```

## app/boards/shields/taw60/Kconfig.defconfig
```kconfig
# Copyright (c) 2021 The ZMK Contributors
# SPDX-License-Identifier: MIT

if SHIELD_TAW60

config ZMK_KEYBOARD_NAME
    default "Taw60"

endif
```

## app/boards/shields/taw60/Kconfig.shield
```kconfig
# Copyright (c) 2020 The ZMK Contributors
# SPDX-License-Identifier: MIT

config SHIELD_TAW60
    def_bool $(shields_list_contains,taw60)
```

## app/boards/shields/taw60_rev/Kconfig.defconfig
```kconfig
# Copyright (c) 2021 The ZMK Contributors
# SPDX-License-Identifier: MIT

if SHIELD_TAW60_REV

config ZMK_KEYBOARD_NAME
    default "Taw60_Rev"

endif
```

## app/boards/shields/taw60_rev/Kconfig.shield
```kconfig
# Copyright (c) 2020 The ZMK Contributors
# SPDX-License-Identifier: MIT

config SHIELD_TAW60_REV
    def_bool $(shields_list_contains,taw60_rev)
```
